## arch/arm/mach-synaptics/drivers/mmc/Kconfig
```kconfig
config MMC_DWCMSHC
	bool "DesignWare Cores Mobile Storage Host Controller"
	depends on DM_MMC && BLK
	depends on MMC_SDHCI
	help
	  Support for DesignWare Cores Mobile Storage Host Controller on Synaptics SOCs
```

## arch/arm/mach-synaptics/drivers/plat/Kconfig
```kconfig
config SYNA_BM
	bool "Enable BM call"
	depends on CMD_SYNA_USBLOAD
	default y

config SYNA_TZ_MR
        bool "Use memory layout from TZ"
        depends on SYNA_SUBOOT

config SYNA_TEE
	bool "Enable Synaptics TEE APIs"
	depends on SYNA_SUBOOT
	default y

config SYNA_SM
	bool "Support System Manager Start in U-Boot"
	depends on SYNA_SUBOOT

config SYNA_INCLUDE_SM_FW
	bool "Build System Manager firmware into U-Boot"
	depends on SYNA_SM
```

## arch/arm/mach-synaptics/drivers/spi/Kconfig
```kconfig
config SYNA_DWSPI
        bool "Synaptics Designware SPI driver"
        help
          Enable the Designware SPI driver. This driver can be used to
          access the SPI NOR flash on platforms embedding this Designware
          IP core.
```

## arch/arm/mach-synaptics/drivers/tee/Kconfig
```kconfig
config SYNA_OPTEE
	bool "Synaptics SoC TEE driver"
	depends on OPTEE
	default y

config SYNA_TA
	bool "Synaptics TA supported in U-Boot"
	depends on SYNA_OPTEE
	default y
```

## board/synaptics/dolphin/Kconfig
```kconfig
if TARGET_DOLPHIN

config SYS_BOARD
	default "dolphin"

config SYS_CONFIG_NAME
	default "dolphin"

endif
```

## board/synaptics/platypus/Kconfig
```kconfig
if TARGET_PLATYPUS

config SYS_BOARD
	default "platypus"

config SYS_CONFIG_NAME
	default "platypus"

endif
```

## configs/platypus_usb_defconfig
```kconfig
CONFIG_ARM=y
CONFIG_POSITION_INDEPENDENT=y
CONFIG_ARM_SMCCC=y
# CONFIG_ARM64_SUPPORT_AARCH32 is not set
CONFIG_ARCH_SYNAPTICS=y
CONFIG_SYS_MALLOC_LEN=0x5c800000
CONFIG_DM_GPIO=y
CONFIG_DEFAULT_DEVICE_TREE="platypus-rdk"
CONFIG_DM_RESET=y
CONFIG_SYS_LOAD_ADDR=0xcf00000
CONFIG_WATCHDOG_TIMEOUT_MSECS=0
CONFIG_TARGET_PLATYPUS=y
CONFIG_MMC_DWCMSHC=y
CONFIG_PHY_SUNPLUS=y
CONFIG_SYNA_RESET=y
CONFIG_SYNA_DWSPI=y
CONFIG_USBCONSOLE=y
CONFIG_CMD_SYNA_USBLOAD=y
# CONFIG_EFI_LOADER is not set
# CONFIG_LEGACY_IMAGE_FORMAT is not set
CONFIG_BOOTDELAY=0
CONFIG_USE_BOOTCOMMAND=y
CONFIG_BOOTCOMMAND="printenv"
CONFIG_USE_PREBOOT=y
CONFIG_PREBOOT="usbload uEnv.txt 0x10000000;env import -t $fileaddr $filesize"
CONFIG_DEFAULT_FDT_FILE="test.dts"
# CONFIG_DISPLAY_CPUINFO is not set
CONFIG_HUSH_PARSER=y
# CONFIG_CMD_BOOTD is not set
# CONFIG_CMD_BOOTM is not set
# CONFIG_CMD_BOOTI is not set
# CONFIG_CMD_ELF is not set
# CONFIG_CMD_FDT is not set
# CONFIG_CMD_GO is not set
# CONFIG_CMD_RUN is not set
# CONFIG_CMD_IMI is not set
# CONFIG_CMD_XIMG is not set
# CONFIG_CMD_EXPORTENV is not set
# CONFIG_CMD_EDITENV is not set
# CONFIG_CMD_SAVEENV is not set
# CONFIG_CMD_CRC32 is not set
# CONFIG_CMD_RANDOM is not set
CONFIG_CMD_UNZIP=y
CONFIG_CMD_DM=y
CONFIG_CMD_GPIO=y
CONFIG_CMD_GPT=y
# CONFIG_CMD_LOADB is not set
# CONFIG_CMD_LOADS is not set
CONFIG_CMD_MMC=y
CONFIG_CMD_BKOPS_ENABLE=y
CONFIG_CMD_MMC_SWRITE=y
# CONFIG_CMD_PINMUX is not set
# CONFIG_CMD_ECHO is not set
# CONFIG_CMD_ITEST is not set
# CONFIG_CMD_SOURCE is not set
# CONFIG_CMD_SETEXPR is not set
CONFIG_SYS_DISABLE_AUTOLOAD=y
CONFIG_CMD_DHCP=y
CONFIG_CMD_MII=y
CONFIG_CMD_PING=y
CONFIG_CMD_CACHE=y
CONFIG_CMD_TIMER=y
CONFIG_DOS_PARTITION=y
CONFIG_OF_CONTROL=y
CONFIG_VERSION_VARIABLE=y
CONFIG_IP_DEFRAG=y
CONFIG_NET_RANDOM_ETHADDR=y
CONFIG_TFTP_BLOCKSIZE=16352
CONFIG_BOUNCE_BUFFER=y
CONFIG_CLK=y
CONFIG_DWAPB_GPIO=y
CONFIG_FXL6408_GPIO=y
CONFIG_DM_I2C=y
CONFIG_SYS_I2C_DW=y
CONFIG_MISC=y
CONFIG_SUPPORT_EMMC_BOOT=y
CONFIG_MMC_IO_VOLTAGE=y
CONFIG_MMC_UHS_SUPPORT=y
CONFIG_MMC_HS400_ES_SUPPORT=y
CONFIG_MMC_HS400_SUPPORT=y
CONFIG_MMC_SDHCI=y
CONFIG_MMC_SDHCI_SDMA=y
CONFIG_MTD=y
CONFIG_MTD_NOR_FLASH=y
CONFIG_USE_SYS_MAX_FLASH_BANKS=y
CONFIG_DM_SPI_FLASH=y
CONFIG_SPI_FLASH_MACRONIX=y
CONFIG_SPI_FLASH_SPANSION=y
CONFIG_SPI_FLASH_STMICRO=y
CONFIG_SPI_FLASH_SST=y
CONFIG_SPI_FLASH_WINBOND=y
# CONFIG_SPI_FLASH_USE_4K_SECTORS is not set
CONFIG_ETH_DESIGNWARE=y
CONFIG_PINCTRL=y
CONFIG_DM_REGULATOR=y
CONFIG_DM_REGULATOR_FIXED=y
CONFIG_DM_REGULATOR_GPIO=y
CONFIG_SPECIFY_CONSOLE_INDEX=y
CONFIG_DM_SERIAL=y
CONFIG_SERIAL_RX_BUFFER=y
CONFIG_SYS_NS16550=y
CONFIG_SPI=y
CONFIG_DM_SPI=y
CONFIG_HEXDUMP=y
# CONFIG_TOOLS_LIBCRYPTO is not set
# CONFIG_TOOLS_KWBIMAGE is not set
```
