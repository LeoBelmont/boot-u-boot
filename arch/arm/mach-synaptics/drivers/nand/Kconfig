## arch/arm/mach-synaptics/drivers/nand/Kconfig
```kconfig
config NAND_RANDOMIZER
	bool "Enable nand randomizer when do nand read/write"
	depends on MTD_SPI_NAND
	default n
```

## arch/arm/mach-synaptics/drivers/net/Kconfig
```kconfig
config PHY_SUNPLUS
	bool  "SUNPLUS Ethernet PHY support"
	help
	  Select this option if your board uses a Sunplus PHY and requires proper
	  initialization and management through the standard PHY framework.

config ETH_ROM_MAC
	bool  "Get MAC address from chip info"
	help
	  Enable this config to retrieve the Ethernet MAC address from non-volatile memory
	  or chip-specific ROM during initialization.

config DWC_ETH_QOS_SYNA
	bool "Synopsys DWC Ethernet QOS device support for Synaptics"
	depends on DWC_ETH_QOS
	help
	  The Synopsys Designware Ethernet QOS IP block with the specific
	  configuration used in Synaptics soc.
```

## arch/arm/mach-synaptics/drivers/pwm/Kconfig
```kconfig
config SYNA_PWM
	bool "Enable support for Synaptics PWM"
	depends on ARCH_SYNAPTICS
	depends on DM_PWM
	help
	  Enabling this config will include the support for the Pulse Width Modulation (PWM)
	  controller on Synaptics SoCs.
```

## arch/arm/mach-synaptics/drivers/regulator/Kconfig
```kconfig
config REGULATOR_RASPBERRYPI_TOUCHSCREEN_ATTINY
	bool "Enable regulator on waveshare raspberry pi touchscreen"
	depends on VIDEO_SYNA
	help
	  Select this option if you are using a Waveshare Raspberry Pi
	  touchscreen display that includes ATtiny-based power control and
	  want the kernel to manage its voltage regulators.
```

## arch/arm/mach-synaptics/drivers/reset/Kconfig
```kconfig
config SYNA_RESET
        bool "Reset controller driver for Synaptcis SoCs"
        depends on DM_RESET && ARCH_SYNAPTICS

config SYNA_SMC_RESET
        bool "SMC(Secure Monitor Call) Reset driver for Synaptcis SoCs"
        depends on DM_RESET && ARCH_SYNAPTICS && ARM_SMCCC
```

## arch/arm/mach-synaptics/drivers/usb/Kconfig
```kconfig
config SYNA_USB_PHY
	bool "Synaptics usb PHY driver"
	depends on ARCH_SYNAPTICS
	default n
	help
	  Select this option to enable support for the USB 2.0/3.0 PHY (Physical Layer) controller
	  used in Synaptics SoCs.

config SYNA_USB_DWC3
	bool "Synaptics Platforms USB DWC3 glue layer"
	depends on ARCH_SYNAPTICS && USB_XHCI_DWC3
	help
	  Select this option to enable the Synaptics-specific glue layer for the DesignWare USB3
	  (DWC3) controller.
```

## arch/arm/mach-synaptics/drivers/usbconsole/Kconfig
```kconfig
config USBCONSOLE
	bool "Synaptics usb console"
	help
	  Select this option to enable support for the Synaptics USB console
	  for debugging
```

## arch/arm/mach-synaptics/drivers/video/Kconfig
```kconfig
config VIDEO_SYNA
	bool "Enable Syna Display support"
	depends on ARCH_SYNAPTICS
	depends on VIDEO
	help
	  This enables support for Synaptics display for
	  Edge Soc family

config PANEL_CFG
	string "Panel Config file"
	depends on VIDEO_SYNA
	help
		Configures the panel information from Header file provided.

config SYNA_DRM_BRIDGE_LT9611
	bool "Syna driver based LT9611 bridge"
	select VIDEO_BRIDGE
	depends on VIDEO_SYNA
	help
	  Enable this option to configures Syna driver based
	  LT9611 bridge support

config SYNA_WSPANEL_1080P
	bool "syna compatible wspanel 1080p resolution"
	depends on VIDEO_SYNA
	help
	  Enable this option to the syna compatible waveshare 13.3 inch panel with
	  1080p resolution

config DEFAULT_PANEL_DTBO
	string "Panel default dtbo file"
	depends on VIDEO_SYNA
	help
		Configures the default panel dtbo to be applied.

config PANEL_DTBO_PATH
	string "Rootfs path to dtbo file"
	depends on VIDEO_SYNA
	help
		Configures the rootfs path to find panel dtbo.

config SYNA_DISABLE_BOOTLOGO
	bool "Disable logo display from uboot and kernel"
	default n
	help
	  Disable logo display in both uboot and kernel.
	  Use this macro to disable logo in a production or usb
	  image, where logo is not available because of missing
	  eMMC/fastlogo.subimg. But display testing is rebuild
	  only after linux bootup.

config SYNA_DISABLE_FBCON
	bool "Disable FBCON in kernel"
	default n
	help
	  Disable FBCON in kernel. When enabled, the kernel will
	  not attach a text console to the fbdev, which prevent
	  console output from appearing on display during boot
	  and runtime. Enable if display pipeline is managed
	  exclusively by userspace(wayland/drm application).
	  Disable for head-less environment without serial console.
```

## board/synaptics/myna2/Kconfig
```kconfig
if TARGET_MYNA2

config SYS_BOARD
	default "myna2"

config SYS_CONFIG_NAME
	default "myna2"

config SYS_BOARD_FPGA
	bool "Run on FPGA board"
	default n
	help
	  Select this option to enable support for running the U-Boot build
	  on an FPGA based version

config SYS_BOARD_VELOCE
	bool "Run on VELOCE board"
	default n
	select SYS_BOARD_FPGA
	help
	  Select this option to enable support for running the U-Boot build
	  on the VELOCE platform

endif
```
